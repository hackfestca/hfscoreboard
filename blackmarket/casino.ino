
#include <Wire.h>   // Uno: A4 (SDA), A5 (SCL)
                    // Mega: 20 (SDA), 21 (SCL)
                    // rpi: 2 (SDA), 3 (SCL)
#include "U8glib.h"

#define I2C_ADDRESS 0x04

#define LED_PIN 13
#define LCD_CONTRAST_PIN  3
#define LCD_BACKLIGHT_PIN 9
#define LCD_CONTRAST      125
#define LCD_FONT_TITLE    u8g_font_9x18
#define LCD_FONT_BODY     u8g_font_6x10

#define LED_LIGHT_UP 0
#define LED_LIGHT_DOWN 1
#define LED_LIGHT_UP 2
#define LED_LIGHT_OFF 3

#define LCD_BANNER 0
#define LCD_NEWS 1
#define LCD_TOP 2

#define FLAG1 "nop"    // Serial
#define FLAG4 "nop"    // qr code. Send the correct value.

U8GLIB_ST7920_128X64 u8g(22, 23, 2, U8G_PIN_NONE); // SPI connection, blanc, vert, orange

boolean FLAG_READY = false;

String lastNews[6];
String lastCountDown = "00:00:00";
String lastTopTeams[3];

#define hf7_width 64
#define hf7_height 46
static unsigned char hf7_bits[] U8G_PROGMEM = {
   0x00, 0x00, 0x00, 0x00, 0x00, 0x00, 0x00, 0x00, 0xfe, 0xff, 0x07, 0x7f,
   0x70, 0xc0, 0xff, 0xff, 0xfe, 0xff, 0x07, 0x7f, 0x70, 0xc0, 0xff, 0xff,
   0xfe, 0xff, 0x07, 0x7f, 0x70, 0xc0, 0xff, 0xff, 0x0e, 0x00, 0xe7, 0x63,
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   0xfe, 0xff, 0xe7, 0x83, 0x83, 0x0f, 0x06, 0xf8 };


void setup(void) {
  Serial.begin(9600);

  // initialize i2c as slave
  Wire.begin(I2C_ADDRESS); 
  
  // define callbacks for i2c communication
  Wire.onReceive(i2c_receiveData);
  Wire.onRequest(i2c_sendData);
  
  pinMode(LED_PIN, OUTPUT);
  pinMode(LCD_CONTRAST_PIN, OUTPUT);
  pinMode(LCD_BACKLIGHT_PIN, OUTPUT);
  digitalWrite(LCD_BACKLIGHT_PIN, HIGH);
  analogWrite(LCD_CONTRAST_PIN, LCD_CONTRAST);
  u8g.setColorIndex(1);

  Serial.println("Ready!");
}

void loop(void) {
  char c;
  String msg;
  char cmd;
  String args;
  draw();

  // Process serial inputs
  if (Serial.available() > 0) {
    while(Serial.available()) {
      c = (char)Serial.read();
      msg += c;
    }

    // say what you got:
    Serial.print("Received (serial): ");
    Serial.println(msg);

    cmd = msg.substring(0,1).c_str()[0];
    args = msg.substring(1);
  
    do_command(cmd,args);
  }
}

void i2c_receiveData(int byteCount){
  char c;
  String msg;
  char cmd;
  String args;
  while(Wire.available()) {
    c = (char)Wire.read();
    msg += c;
  }
  
  Serial.print("Byte Count: ");
  Serial.println(byteCount);
  Serial.print("data received: ");
  Serial.println(msg.c_str());    

  cmd = msg.substring(0,1).c_str()[0];
  args = msg.substring(1);

  do_command(cmd,args);
}

void i2c_sendData(){

}

void do_command(char cmd, String args){
  Serial.print("Processing command: ");
  Serial.println(cmd);
  switch (cmd) {
    case 'c': updateCountDown(args); break;
    case 'n': updateNews(args); break;
    case 't': updateTop(args); break;
    case 'f': printFlag(args); break;    
    default: break;
  }  
}

void updateCountDown(String args){
  lastCountDown = args;
}

void updateNews(String args){
  char c = args.substring(0,1).c_str()[0];
  int line = c-'0';
  if (line >= 0 && line <= 5){
    lastNews[line] = args.substring(1);
  }
}

void updateTop(String args){
  char c = args.substring(0,1).c_str()[0];
  int line = c-'0';
  if (line >= 0 && line <= 3){
    lastTopTeams[line] = args.substring(1);
  }
}

void printFlag(String args){
  FLAG_READY = true;
}

void draw(void){
  int chgPageDelay = 10000;

  // Print banner
  drawBanner(chgPageDelay);

  // Print count down
  drawCountDown(chgPageDelay);

  // Print news
  drawNews(chgPageDelay);

  // Print top teams
  drawTopTeams(chgPageDelay);

  // Print a flag
  if (FLAG_READY){
    drawFlag(2*chgPageDelay);
    FLAG_READY = false;
  }
}

void drawStrMultiLine(String str[], int lineCt, int lineSpace = 8){
  int topMargin = 23;
  int leftMargin = 5;
  int colSpace = topMargin;

  for (int i=0; i<lineCt; i++){
    u8g.drawStr(leftMargin, colSpace, str[i].c_str());
    colSpace += lineSpace;
  }
}

void drawBanner(int chgPageDelay) {
  u8g.firstPage();
  do { 
    u8g.drawFrame(0,0,128,64);
    
    u8g.setFont(u8g_font_10x20);
    u8g.drawCircle(18,18,14);
    u8g.drawStr(10, 26, "HF");
    u8g.drawStr(38, 26, "Casino");
  
    u8g.setFont(u8g_font_6x10);
    u8g.drawStr(4, 50, "We got tokens!");
  } while (u8g.nextPage());  
  delay(chgPageDelay);  
}

void drawCountDown(int chgPageDelay){
  u8g.firstPage();
  do { 
    u8g.drawFrame(0,0,128,64);
    
    u8g.setFont(LCD_FONT_TITLE);
    u8g.drawStr(1, 13, "Time left");  

    u8g.setFont(u8g_font_fur20);
    u8g.drawStr(7, 45, lastCountDown.c_str());      
  } while (u8g.nextPage());  
  delay(chgPageDelay);      
}

void drawNews(int chgPageDelay) {
  u8g.firstPage();
  do { 
    u8g.setFont(LCD_FONT_TITLE);
    u8g.drawStr(0, 10, "News");

    u8g.setFont(LCD_FONT_BODY);
    drawStrMultiLine(lastNews,6,8);
  } while (u8g.nextPage());  
  delay(chgPageDelay);  
}

void drawTopTeams(int chgPageDelay) {
  u8g.firstPage();
  do { 
    u8g.setFont(LCD_FONT_TITLE);
    u8g.drawStr(0, 10, "Top 3");

    u8g.setFont(u8g_font_7x13);
    drawStrMultiLine(lastTopTeams,3,15);
  } while (u8g.nextPage());  
  delay(chgPageDelay);  
}

void drawFlag(int chgPageDelay) {
  u8g.firstPage();
  do {  
    u8g.setFont(LCD_FONT_TITLE);
    u8g.drawStr(0, 10, "Flag");
        
    u8g.drawXBMP(64,0,hf7_width,hf7_height,hf7_bits);
  } while (u8g.nextPage());
  delay(chgPageDelay);
}

